/*
 * Copyright (c) 2024 The ZMK Contributors
 * SPDX-License-Identifier: MIT
 */

#include "luxeria.dtsi"

// Seeeduino XIAO BLE pinout:
// D0  = &xiao_d 0  (P0.02)
// D1  = &xiao_d 1  (P0.03)
// D2  = &xiao_d 2  (P0.28)
// D3  = &xiao_d 3  (P0.29)
// D4  = &xiao_d 4  (P0.04)
// D5  = &xiao_d 5  (P0.05)
// D6  = &xiao_d 6  (P1.11)
// D7  = &xiao_d 7  (P1.12)
// D8  = &xiao_d 8  (P1.13)
// D9  = &xiao_d 9  (P1.14)
// D10 = &xiao_d 10 (P1.15)
// D11 = &gpio0 15  (P0.15) - xiao_dに定義されていないので直接指定

&kscan0 {
    row-gpios
        = <&xiao_d 0 (GPIO_ACTIVE_HIGH | GPIO_PULL_DOWN)>
        , <&xiao_d 1 (GPIO_ACTIVE_HIGH | GPIO_PULL_DOWN)>
        , <&xiao_d 2 (GPIO_ACTIVE_HIGH | GPIO_PULL_DOWN)>
        , <&xiao_d 3 (GPIO_ACTIVE_HIGH | GPIO_PULL_DOWN)>
        , <&xiao_d 4 (GPIO_ACTIVE_HIGH | GPIO_PULL_DOWN)>
        ;
    col-gpios
        = <&xiao_d 5 GPIO_ACTIVE_HIGH>
        , <&xiao_d 6 GPIO_ACTIVE_HIGH>
        , <&xiao_d 7 GPIO_ACTIVE_HIGH>
        , <&xiao_d 8 GPIO_ACTIVE_HIGH>
        , <&xiao_d 9 GPIO_ACTIVE_HIGH>
        , <&xiao_d 10 GPIO_ACTIVE_HIGH>
        , <&gpio0 15 GPIO_ACTIVE_HIGH>
        ;
};
