## .github/boards/shields/luxeria/Kconfig.defconfig
```kconfig
# Copyright (c) 2024 The ZMK Contributors
# SPDX-License-Identifier: MIT

if SHIELD_LUXERIA_LEFT

config ZMK_KEYBOARD_NAME
    default "Luxeria"

config ZMK_SPLIT_ROLE_CENTRAL
    default n

endif

if SHIELD_LUXERIA_RIGHT

config ZMK_KEYBOARD_NAME
    default "Luxeria"

config ZMK_SPLIT_ROLE_CENTRAL
    default y

config INPUT
    bool
    default y

config SPI
    bool
    default y

config ZMK_POINTING
    bool
    default y

config PMW3610
    bool
    default y

endif

if SHIELD_LUXERIA_LEFT || SHIELD_LUXERIA_RIGHT

config ZMK_SPLIT
    default y

endif
```

## .github/boards/shields/luxeria/Kconfig.shield
```kconfig
# Copyright (c) 2024 The ZMK Contributors
# SPDX-License-Identifier: MIT

config SHIELD_LUXERIA_LEFT
    def_bool $(shields_list_contains,luxeria_left)

config SHIELD_LUXERIA_RIGHT
    def_bool $(shields_list_contains,luxeria_right)
```

## config/boards/shields/oled_test/Kconfig.defconfig
```kconfig
# Copyright (c) 2024 The ZMK Contributors
# SPDX-License-Identifier: MIT

if SHIELD_OLED_TEST

config ZMK_KEYBOARD_NAME
    default "OLED Test"

config LV_Z_VDB_SIZE
    default 64

config LV_DPI_DEF
    default 148

config LV_Z_BITS_PER_PIXEL
    default 1

choice LV_COLOR_DEPTH
    default LV_COLOR_DEPTH_1
endchoice

endif
```

## config/boards/shields/oled_test/Kconfig.shield
```kconfig
# Copyright (c) 2024 The ZMK Contributors
# SPDX-License-Identifier: MIT

config SHIELD_OLED_TEST
    def_bool $(shields_list_contains,oled_test)
```
